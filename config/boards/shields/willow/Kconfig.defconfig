## config/boards/shields/willow/Kconfig.defconfig
```kconfig
if SHIELD_WILLOW_DONGLE

    config ZMK_KEYBOARD_NAME
        default "Willow"

    config ZMK_SPLIT_ROLE_CENTRAL
        default y

    config ZMK_SPLIT
        default y

    # Prevent the dongle from going to sleep
    config ZMK_SLEEP
        default n

    # Increase the transmit power of the dongle
    config BT_CLTR_TX_PWR_PLUS_8
        default y

endif

if SHIELD_WILLOW
    config ZMK_KEYBOARD_NAME
        default "Willow"

endif
```

## config/boards/shields/willow/Kconfig.shield
```kconfig
config SHIELD_WILLOW
    def_bool $(shields_list_contains,willow)

config SHIELD_WILLOW_DONGLE
    def_bool $(shields_list_contains,willow_dongle)
```
